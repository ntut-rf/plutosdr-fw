## Config.in
```kconfig
comment "HDL"

config VIVADO_VERSION
    string "Vivado version"
    default "2019.1"
    help
      Vivado version

config VIVADO_SETTINGS
    string "Path to Vivado settings"
    default "/opt/Xilinx/Vivado/$(VIVADO_VERSION)/settings64.sh"
    help
      Path to Vivado settings

config HDL_PROJECT
    string "HDL project name"
    default "pluto"
    help

comment "System"

config COMPLETE_NAME
    string "Device Complete Name"
    default ""
    help
      Device Complete Name

config DEVICE_VID
    string "Device VID"
    default "0x0456"
    help
      Device VID

config DEVICE_PID
    string "Device PID"
    default "0xb673"
    help
      Device PID

comment "AD936x System"

source "../package/libini/Config.in"
source "../package/libad9361-iio/Config.in"
source "../package/poll_sysfs/Config.in"
source "../package/ad936x_ref_cal/Config.in"
source "../package/ad9361-dts/Config.in"
source "../package/pluto-overlay/Config.in"
source "../package/motd/Config.in"

comment "AD936x Apps"

source "../package/retrogram-plutosdr/Config.in"
source "../package/iio-fm-radio/Config.in"
source "../package/gr-iio/Config.in"

comment "Xilinx"

source "../package/device-tree-xlnx/Config.in.host"
source "../package/xilinx_axidma/Config.in"
source "../package/xfft-test/Config.in"

comment "SISO"

source "../package/sse2neon/Config.in"
source "../package/SISO/Config.in"
source "../package/SISO2/Config.in"

comment "HTTP3a"

source "../package/zmq_routing/Config.in"
```

## configs/Config.in
```kconfig
source "$BR2_EXTERNAL_PLUTOSDR_PATH/package/fftwf/Config.in"
source "$BR2_EXTERNAL_PLUTOSDR_PATH/package/libini/Config.in"
menu "Applications and Tools for PlutoSDR, M2k & SidekiqZ2"
   source "$BR2_EXTERNAL_PLUTOSDR_PATH/package/libad9361-iio/Config.in"
   source "$BR2_EXTERNAL_PLUTOSDR_PATH/package/poll_sysfs/Config.in"
   source "$BR2_EXTERNAL_PLUTOSDR_PATH/package/ad936x_ref_cal/Config.in"
   source "$BR2_EXTERNAL_PLUTOSDR_PATH/package/gr-iio/Config.in"
   source "$BR2_EXTERNAL_PLUTOSDR_PATH/package/libosmoplutosdr/Config.in"
endmenu
```

## configs/adrv9364_defconfig
```kconfig
BR2_arm=y
BR2_cortex_a9=y
BR2_ARM_ENABLE_NEON=y
BR2_ARM_ENABLE_VFP=y
BR2_ARM_FPU_NEON=y
BR2_CCACHE=y
BR2_CCACHE_DIR="$(TOPDIR)/.buildroot-ccache"
BR2_TOOLCHAIN_EXTERNAL=y
BR2_TOOLCHAIN_EXTERNAL_CUSTOM=y
BR2_TOOLCHAIN_EXTERNAL_PATH="/opt/Xilinx/SDK/2018.2/gnu/aarch32/lin/gcc-arm-linux-gnueabi"
BR2_TOOLCHAIN_EXTERNAL_CUSTOM_PREFIX="arm-linux-gnueabihf"
BR2_TOOLCHAIN_EXTERNAL_GCC_7=y
BR2_TOOLCHAIN_EXTERNAL_HEADERS_4_9=y
BR2_TOOLCHAIN_EXTERNAL_CUSTOM_GLIBC=y
BR2_TOOLCHAIN_EXTERNAL_CXX=y
BR2_TARGET_GENERIC_HOSTNAME="adrv"
BR2_TARGET_GENERIC_ISSUE="Welcome to ADRV"
BR2_ROOTFS_DEVICE_CREATION_DYNAMIC_MDEV=y
BR2_ROOTFS_MERGED_USR=y
BR2_TARGET_GENERIC_ROOT_PASSWD="analog"
BR2_TARGET_GENERIC_GETTY_PORT="ttyPS0"
BR2_ROOTFS_OVERLAY="$(BR2_EXTERNAL)/rootfs_overlay/"
BR2_ROOTFS_POST_BUILD_SCRIPT="$(BR2_EXTERNAL)/post-build.sh"
BR2_LINUX_KERNEL=y
BR2_LINUX_KERNEL_CUSTOM_GIT=y
BR2_LINUX_KERNEL_CUSTOM_REPO_URL="https://github.com/analogdevicesinc/linux.git"
BR2_LINUX_KERNEL_CUSTOM_REPO_VERSION="3a85d2e"
BR2_LINUX_KERNEL_DEFCONFIG="zynq_xcomm_adv7511"
BR2_LINUX_KERNEL_CONFIG_FRAGMENT_FILES="$(BR2_EXTERNAL)/linux-extras-adrv9364.config"
BR2_LINUX_KERNEL_UIMAGE=y
BR2_LINUX_KERNEL_UIMAGE_LOADADDR="0x8000"
BR2_LINUX_KERNEL_DTS_SUPPORT=y
BR2_LINUX_KERNEL_INTREE_DTS_NAME="zynq-adrv9364-z7020-bob"
BR2_PACKAGE_BUSYBOX_CONFIG="$(BR2_EXTERNAL)/busybox-1.25.0.config"
BR2_PACKAGE_BUSYBOX_CONFIG_FRAGMENT_FILES="$(BR2_EXTERNAL)/busybox-extras.config"
BR2_PACKAGE_STRACE=y
BR2_PACKAGE_MTD=y
# BR2_PACKAGE_MTD_NANDDUMP is not set
# BR2_PACKAGE_MTD_NANDTEST is not set
# BR2_PACKAGE_MTD_NANDWRITE is not set
# BR2_PACKAGE_MTD_UBIATTACH is not set
# BR2_PACKAGE_MTD_UBICRC32 is not set
# BR2_PACKAGE_MTD_UBIDETACH is not set
# BR2_PACKAGE_MTD_UBIFORMAT is not set
# BR2_PACKAGE_MTD_UBIMKVOL is not set
# BR2_PACKAGE_MTD_UBINFO is not set
# BR2_PACKAGE_MTD_UBINIZE is not set
# BR2_PACKAGE_MTD_UBIRENAME is not set
# BR2_PACKAGE_MTD_UBIRMVOL is not set
# BR2_PACKAGE_MTD_UBIRSVOL is not set
# BR2_PACKAGE_MTD_UBIUPDATEVOL is not set
# BR2_PACKAGE_MTD_UBIBLOCK is not set
BR2_PACKAGE_NFS_UTILS=y
BR2_PACKAGE_LINUX_FIRMWARE=y
BR2_PACKAGE_INPUT_EVENT_DAEMON=y
BR2_PACKAGE_UBOOT_TOOLS=y
BR2_PACKAGE_PYTHON=y
# BR2_PACKAGE_PYTHON_UNICODEDATA is not set
BR2_PACKAGE_ZLIB=y
BR2_PACKAGE_LIBIIO_IIOD_USBD=y
BR2_PACKAGE_LIBIIO_TESTS=y
BR2_PACKAGE_LIQUID_DSP=y
BR2_PACKAGE_LIQUID_DSP_FAST=y
BR2_PACKAGE_GNURADIO=y
BR2_PACKAGE_GNURADIO_AUDIO=y
BR2_PACKAGE_GNURADIO_CTRLPORT=y
BR2_PACKAGE_GNURADIO_FEC=y
BR2_PACKAGE_GNURADIO_PYTHON=y
BR2_PACKAGE_GNURADIO_CHANNELS=y
BR2_PACKAGE_GNURADIO_DIGITAL=y
BR2_PACKAGE_GR_OSMOSDR=y
BR2_PACKAGE_GR_OSMOSDR_PYTHON=y
BR2_PACKAGE_AVAHI=y
BR2_PACKAGE_AVAHI_DAEMON=y
BR2_PACKAGE_AVAHI_LIBDNSSD_COMPATIBILITY=y
BR2_PACKAGE_DROPBEAR=y
BR2_PACKAGE_IPERF3=y
BR2_PACKAGE_IPROUTE2=y
BR2_PACKAGE_HTOP=y
BR2_PACKAGE_NANO=y
BR2_TARGET_ROOTFS_EXT2=y
BR2_TARGET_ROOTFS_EXT2_4=y
BR2_TARGET_ROOTFS_EXT2_SIZE="150M"
# BR2_TARGET_ROOTFS_TAR is not set
BR2_TARGET_UBOOT=y
BR2_TARGET_UBOOT_BUILD_SYSTEM_KCONFIG=y
BR2_TARGET_UBOOT_CUSTOM_GIT=y
BR2_TARGET_UBOOT_CUSTOM_REPO_URL="https://github.com/analogdevicesinc/u-boot-xlnx.git"
BR2_TARGET_UBOOT_CUSTOM_REPO_VERSION="099c929"
BR2_TARGET_UBOOT_BOARD_DEFCONFIG="zynq_adrv9364"
# BR2_TARGET_UBOOT_FORMAT_BIN is not set
BR2_TARGET_UBOOT_FORMAT_ELF=y
BR2_PACKAGE_HOST_DOSFSTOOLS=y
BR2_PACKAGE_HOST_GENIMAGE=y
BR2_PACKAGE_LIBINI=y
BR2_PACKAGE_POLL_SYSFS=y
BR2_PACKAGE_AD936X_REF_CAL=y
BR2_PACKAGE_GR_IIO=y
BR2_PACKAGE_RETROGRAM_PLUTOSDR=y
```

## configs/package/fftw/Config.in
```kconfig
source "package/fftw/fftw/Config.in"

if BR2_PACKAGE_FFTW
	config BR2_PACKAGE_FFTW_USE_SSE
		bool

	config BR2_PACKAGE_FFTW_USE_SSE2
		bool

	config BR2_PACKAGE_FFTW_USE_NEON
		bool

	config BR2_PACKAGE_FFTW_FAST
		bool "optimise for speed over accuracy"
		help
		  Optimise for fast math functions, at the expense of accuracy.

		  Say 'y' if you need speed and can live with inaccuracies in
		  the results. Say 'n' (the default) if accuracy is of utmost
		  importance.

		  This basically uses gcc's -Ofast optimisation level, which in
		  turn is basically using gcc's -ffast-math. See the gcc manual
		  for what this means.

	source "package/fftw/fftwf/Config.in"
	source "package/fftw/fftwl/Config.in"
	source "package/fftw/fftwq/Config.in"

endif
```

## configs/package/fftw/fftw/Config.in
```kconfig
config BR2_PACKAGE_FFTW
	bool "fftw"
	select BR2_PACKAGE_FFTW_PRECISION_DOUBLE
	help
	  Library for computing Fast Fourier Transforms in double precision.

	  This library computes Fast Fourier Transforms (FFT) in one
	  or more dimensions. It is extremely fast. This package
	  contains the shared library version of the fftw libraries in
	  double precision.

	  http://www.fftw.org

config BR2_PACKAGE_FFTW_PRECISION_DOUBLE
	bool
	select BR2_PACKAGE_FFTW_USE_SSE2 if BR2_X86_CPU_HAS_SSE2
	help
	  Compile fftw in double precision (the default), i.e. use 'double'
	  for floating point type.
```

## configs/package/fftw/fftwf/Config.in
```kconfig
config BR2_PACKAGE_FFTWF
	bool "fftwf"
	select BR2_PACKAGE_FFTW_PRECISION_SINGLE
	help
	  Library for computing Fast Fourier Transforms in single precision.

	  This library computes Fast Fourier Transforms (FFT) in one
	  or more dimensions. It is extremely fast. This package
	  contains the shared library version of the fftw libraries in
	  double precision.

	  http://www.fftw.org

config BR2_PACKAGE_FFTW_PRECISION_SINGLE
	bool
	select BR2_PACKAGE_FFTW_USE_SSE if BR2_X86_CPU_HAS_SSE
	select BR2_PACKAGE_FFTW_USE_SSE2 if BR2_X86_CPU_HAS_SSE2
	select BR2_PACKAGE_FFTW_USE_NEON if BR2_ARM_CPU_HAS_NEON && !BR2_ARM_SOFT_FLOAT
	help
	  Compile fftw in single precision, i.e. use 'float' for floating
	  point type.
```

## configs/package/fftw/fftwl/Config.in
```kconfig
config BR2_PACKAGE_FFTWL
	bool "fftwl"
	select BR2_PACKAGE_FFTW_PRECISION_LONG_DOUBLE
	help
	  Library for computing Fast Fourier Transforms in long double precision.

	  This library computes Fast Fourier Transforms (FFT) in one
	  or more dimensions. It is extremely fast. This package
	  contains the shared library version of the fftw libraries in
	  double precision.

	  http://www.fftw.org

config BR2_PACKAGE_FFTW_PRECISION_LONG_DOUBLE
	bool
	# long-double precision require long-double trigonometric routines
	depends on !(BR2_TOOLCHAIN_BUILDROOT_UCLIBC && \
		(BR2_arm || BR2_mips || BR2_mipsel))
	help
	  Compile fftw in long double precision, i.e. use 'long double'
	  for floating point type.
```

## configs/package/fftw/fftwq/Config.in
```kconfig
config BR2_PACKAGE_FFTWQ
	bool "fftwq"
	select BR2_PACKAGE_FFTW_PRECISION_QUAD
	help
	  Library for computing Fast Fourier Transforms in quad precision.

	  This library computes Fast Fourier Transforms (FFT) in one
	  or more dimensions. It is extremely fast. This package
	  contains the shared library version of the fftw libraries in
	  double precision.

	  http://www.fftw.org

config BR2_PACKAGE_FFTW_PRECISION_QUAD
	bool
	# quad-precision needs to have a gcc with libquadmath
	depends on (BR2_i386 || BR2_x86_64) && BR2_USE_WCHAR
	help
	  Compile fftw in quadruple precision, i.e. use '__float128' for
	  floating point type.
```

## configs/package/fftwf/Config.in
```kconfig
config BR2_PACKAGE_FFTWF
	bool "fftwf"
	select BR2_PACKAGE_FFTW_PRECISION_SINGLE
	help
	  Library for computing Fast Fourier Transforms in single precision.

	  This library computes Fast Fourier Transforms (FFT) in one
	  or more dimensions. It is extremely fast. This package
	  contains the shared library version of the fftw libraries in
	  single precision.

	  http://www.fftw.org
```

## configs/package/gr-iio/Config.in
```kconfig
config BR2_PACKAGE_GR_IIO
        bool "gr-iio"
        help
          IIO blocks for GNU Radio

          https://github.com/analogdevicesinc/gr-iio
```

## configs/package/soapy-remote/Config.in
```kconfig
config BR2_PACKAGE_SOAPY_REMOTE
	bool "soapy-remote"
	select BR2_PACKAGE_SOAPY_SDR
	help
	  Use any Soapy SDR remotely

	  https://github.com/pothosware/SoapyRemote.git
```

## configs/package/xpra/Config.in
```kconfig
config BR2_PACKAGE_XPRA
	bool "xpra"
	help
	  Multi-platform screen and application forwarding system

	  https://xpra.org
```

## package-unmaintained/multimon-ng/Config.in
```kconfig
config BR2_PACKAGE_MULTIMON_NG
	bool "multimon-ng"
	help
      https://github.com/EliasOenal/multimon-ng.git
```

## package-unmaintained/soapy-plutosdr/Config.in
```kconfig
config BR2_PACKAGE_SOAPY_PLUTOSDR
	bool "soapy-plutosdr"
	depends on BR2_TOOLCHAIN_HAS_THREADS
	select BR2_PACKAGE_SOAPY_SDR
	select BR2_PACKAGE_LIBIIO
	select BR2_PACKAGE_LIBAD9361_IIO
	help
	  Soapy SDR plugin for PlutoSDR
	  
	  https://github.com/jocover/SoapyPlutoSDR.git
```

## package/SISO/Config.in
```kconfig
config BR2_PACKAGE_SISO
	bool "SISO"
	select BR2_PACKAGE_XILINX_AXIDMA
	select BR2_PACKAGE_SSE2NEON
	select BR2_PACKAGE_GNURADIO
	select BR2_PACKAGE_LIBIIO
	help
      
```

## package/SISO2/Config.in
```kconfig
config BR2_PACKAGE_SISO2
	bool "SISO2"
	select BR2_PACKAGE_XILINX_AXIDMA
	select BR2_PACKAGE_SSE2NEON
	select BR2_PACKAGE_GNURADIO
	select BR2_PACKAGE_LIBIIO
	help
      
```

## package/ad9361-dts/Config.in
```kconfig
config BR2_PACKAGE_AD9361_DTS
	bool "ad9361-dts"
	select BR2_PACKAGE_HOST_DEVICE_TREE_XLNX 
	help
	  Custom device tree source for AD9361

      
```

## package/ad936x-boot-img/Config.in
```kconfig
config BR2_PACKAGE_AD936X_BOOT_IMG
	bool "ad936x-boot-img"
	select BR2_PACKAGE_AD936X_FSBL
	help
	  Boot image for AD936x

      
```

## package/ad936x-dts/Config.in
```kconfig
config BR2_PACKAGE_AD936X_DTS
	bool "ad936x-dts"
	select BR2_PACKAGE_HOST_DEVICE_TREE_XLNX 
	select BR2_PACKAGE_AD936X_HDL
	help
	  Custom device tree source for AD936x

      
```

## package/ad936x-fsbl/Config.in
```kconfig
config BR2_PACKAGE_AD936X_FSBL
	bool "ad936x-fsbl"
	select BR2_PACKAGE_AD936X_HDL
	help
	  First stage bootloader for AD936x

      
```

## package/ad936x-hdl/Config.in
```kconfig
config BR2_PACKAGE_AD936X_HDL
	bool "ad936x-hdl"
	help
	  HDL for AD936x

      
```

## package/ad936x-uboot-env/Config.in
```kconfig
config BR2_PACKAGE_AD936X_UBOOT_ENV
	bool "ad936x-uboot-env"
	help
	  uboot-env for AD936x
```

## package/device-tree-xlnx/Config.in.host
```kconfig
config BR2_PACKAGE_HOST_DEVICE_TREE_XLNX
	bool "host device-tree-xlnx"
	help
	  Linux device tree generator for the Xilinx SDK.

	  https://github.com/Xilinx/device-tree-xlnx
```

## package/gr-iio/Config.in
```kconfig
config BR2_PACKAGE_GR_IIO
	bool "gr-iio"
	select BR2_PACKAGE_LIBAD9361_IIO
	select BR2_PACKAGE_LIBIIO
	select BR2_PACKAGE_BOOST
	select BR2_PACKAGE_GNURADIO
	help
      IIO blocks for GNU Radio

      https://github.com/analogdevicesinc/gr-iio
```

## package/iio-fm-radio/Config.in
```kconfig
config BR2_PACKAGE_IIO_FM_RADIO
	bool "iio-fm-radio"
	select BR2_PACKAGE_LIBIIO
	help
      Simple IIO FM Radio receive example.

      https://github.com/analogdevicesinc/iio-fm-radio
```
