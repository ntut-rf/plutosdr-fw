## package/itpp/Config.in
```kconfig
config BR2_PACKAGE_ITPP
        bool "itpp"
        help
          IT++ is a C++ library of mathematical, signal processing and communication classes and functions.

          http://itpp.sourceforge.net
```

## package/leansdr/Config.in
```kconfig
config BR2_PACKAGE_LEANSDR
	bool "leansdr"
    select BR2_PACKAGE_FFTW
	select BR2_PACKAGE_FFTW_SINGLE
    select BR2_PACKAGE_LIBIIO
	help
	  Lightweight, portable software-defined radio
```

## package/mb_remoteproc/Config.in
```kconfig
config BR2_PACKAGE_MB_REMOTEPROC
	bool "mb_remoteproc"
	help
	  Support Microblaze remoteproc
```

## package/motd/Config.in
```kconfig
config BR2_PACKAGE_MOTD
	bool "motd"
	help
	  Message of the day

if BR2_PACKAGE_MOTD
choice
	prompt "motd message"
	default BR2_PACKAGE_MOTD_PLUTOSDR
	help
	  Set the motd message

config BR2_PACKAGE_MOTD_PLUTOSDR
	bool "PlutoSDR"
	help
	  PlutoSDR

config BR2_PACKAGE_MOTD_ADRV9364
	bool "ADRV9364"
	help
	  ADRV9364

endchoice
endif
```

## package/retrogram-plutosdr/Config.in
```kconfig
config BR2_PACKAGE_RETROGRAM_PLUTOSDR
	bool "retrogram-plutosdr"
	select BR2_PACKAGE_LIBAD9361_IIO
	select BR2_PACKAGE_BOOST
	select BR2_PACKAGE_NCURSES
	help
	  Wideband Spectrum analyzer on your terminal/ssh console with ASCII art.
	  
```

## package/siso/Config.in
```kconfig
config BR2_PACKAGE_SISO
	bool "SISO"
	select BR2_PACKAGE_XILINX_AXIDMA
	select BR2_PACKAGE_SSE2NEON
	help
      
```

## package/soapy-sdr/Config.in
```kconfig
config BR2_PACKAGE_SOAPY_SDR
	bool "soapy-sdr"
	help
	  Vendor and platform neutral SDR support library

	  https://github.com/pothosware/SoapySDR.git
```

## package/sse2neon/Config.in
```kconfig
config BR2_PACKAGE_SSE2NEON
    bool "sse2neon"
    help
      C/C++ header converting Intel SSE intrinsics to Arm/Aarch64 NEON intrinsics

      https://github.com/DLTcollab/sse2neon
```

## package/xfft-test/Config.in
```kconfig
config BR2_PACKAGE_XFFT_TEST
	bool "xfft-test"
	select BR2_PACKAGE_XILINX_AXIDMA
	help
	  XFFT test program.
	  
```

## package/xilinx_axidma/Config.in
```kconfig
config BR2_PACKAGE_XILINX_AXIDMA
	bool "xilinx_axidma"
	help
	  A zero-copy Linux driver and a userspace interface library for Xilinx's AXI DMA and VDMA IP blocks.
	  
```

## package/zmq_routing/Config.in
```kconfig
config BR2_PACKAGE_ZMQ_ROUTING
	bool "ZeroMQ routing"
	select BR2_PACKAGE_PYTHON_PYZMQ
	help
      
```

## scripts/adrv9364z7020.its
```
/*
 * U-Boot uImage source file with multiple kernels, ramdisks and FDT blobs
 * This example makes use of the 'loadables' field
 */

/*
 * fdt get addr foo /images/fdt@1 data
 */

/dts-v1/;

/ {
	description = "Configuration to load fpga before Kernel";
	magic = "ITB ADRV9364Z7020";
	#address-cells = <1>;
	images {

		fdt@1 {
			description = "zynq-adrv9364-z7020-bob";
			data = /incbin/("../buildroot/output/images/zynq-adrv9364-z7020-bob.dtb");
			type = "flat_dt";
			arch = "arm";
			compression = "none";
		};

		fpga@1 {
			description = "FPGA";
			data = /incbin/("../build/adrv9364z7020/sdk/hw_0/system_top.bit");
			type = "fpga";
			arch = "arm";
			compression = "none";
			load = <0xF000000>;
			hash@1 {
				algo = "md5";
			};
		};

		linux_kernel@1 {
			description = "Linux";
			data = /incbin/("../buildroot/output/images/zImage");
			type = "kernel";
			arch = "arm";
			os = "linux";
			compression = "none";
			load = <0x8000>;
			entry = <0x8000>;
			hash@1 {
				algo = "md5";
			};
		};
		ramdisk@1 {
			description = "Ramdisk";
			data = /incbin/("../buildroot/output/images/rootfs.cpio.xz");
			type = "ramdisk";
			arch = "arm";
			os = "linux";
			compression = "xz";
			hash@1 {
				algo = "md5";
			};
		};

	};

	configurations {
		default = "config@0";
		config@0 {
			description = "Linux with fpga RevA";
			fdt = "fdt@1";
			kernel = "linux_kernel@1";
			ramdisk = "ramdisk@1";
			fpga = "fpga@1";
		};

	};
};
```

## targets/adrv9364/defconfig
```kconfig
BR2_arm=y
BR2_cortex_a9=y
BR2_ARM_ENABLE_NEON=y
BR2_ARM_ENABLE_VFP=y
BR2_ARM_FPU_NEON=y
BR2_HOST_DIR="$(BR2_EXTERNAL)/build/host"
BR2_CCACHE=y
BR2_GLOBAL_PATCH_DIR="$(BR2_EXTERNAL)/patches/ $(BR2_EXTERNAL)/patches/adrv9364"
BR2_REPRODUCIBLE=y
# BR2_PIC_PIE is not set
BR2_SSP_NONE=y
BR2_RELRO_NONE=y
BR2_FORTIFY_SOURCE_NONE=y
BR2_TOOLCHAIN_BUILDROOT_GLIBC=y
BR2_PACKAGE_HOST_LINUX_HEADERS_CUSTOM_5_4=y
BR2_BINUTILS_VERSION_2_37_X=y
BR2_GCC_VERSION_11_X=y
BR2_TOOLCHAIN_BUILDROOT_CXX=y
BR2_TOOLCHAIN_BUILDROOT_FORTRAN=y
BR2_GCC_ENABLE_LTO=y
BR2_GCC_ENABLE_OPENMP=y
BR2_TARGET_GENERIC_HOSTNAME="adrv"
BR2_TARGET_GENERIC_ISSUE="Welcome to ADRV9364"
BR2_ROOTFS_DEVICE_CREATION_DYNAMIC_MDEV=y
BR2_ROOTFS_MERGED_USR=y
BR2_TARGET_GENERIC_ROOT_PASSWD="analog"
BR2_TARGET_GENERIC_GETTY_PORT="ttyPS0"
BR2_SYSTEM_DEFAULT_PATH="/bin:/sbin:/usr/bin:/usr/sbin"
BR2_TARGET_TZ_INFO=y
BR2_TARGET_LOCALTIME="ROC"
BR2_ROOTFS_OVERLAY="$(BR2_EXTERNAL)/platform/rootfs_overlay/"
BR2_ROOTFS_POST_BUILD_SCRIPT="$(BR2_EXTERNAL)/platform/post-build.sh"
BR2_ROOTFS_POST_IMAGE_SCRIPT="$(BR2_EXTERNAL)/targets/adrv9364/post-image.sh"
BR2_LINUX_KERNEL=y
BR2_LINUX_KERNEL_CUSTOM_GIT=y
BR2_LINUX_KERNEL_CUSTOM_REPO_URL="https://github.com/analogdevicesinc/linux.git"
BR2_LINUX_KERNEL_CUSTOM_REPO_VERSION="424e677"
BR2_LINUX_KERNEL_DEFCONFIG="zynq_xcomm_adv7511"
BR2_LINUX_KERNEL_CONFIG_FRAGMENT_FILES="$(BR2_EXTERNAL)/targets/adrv9364/linux-extras.config"
BR2_LINUX_KERNEL_UIMAGE=y
BR2_LINUX_KERNEL_UIMAGE_LOADADDR="0x8000"
BR2_LINUX_KERNEL_DTS_SUPPORT=y
BR2_LINUX_KERNEL_INTREE_DTS_NAME="zynq-adrv9364-z7020-bob"
BR2_LINUX_KERNEL_CUSTOM_DTS_PATH="$(BASE_DIR)/dts/*.dtsi $(BR2_EXTERNAL)/targets/adrv9364/*.dtsi"
BR2_PACKAGE_BUSYBOX_CONFIG="$(BR2_EXTERNAL)/platform/busybox-1.25.0.config"
BR2_PACKAGE_BUSYBOX_CONFIG_FRAGMENT_FILES="$(BR2_EXTERNAL)/platform/busybox-extras.config"
BR2_PACKAGE_BUSYBOX_SHOW_OTHERS=y
BR2_PACKAGE_GSTREAMER1=y
BR2_PACKAGE_GST1_PLUGINS_GOOD_PLUGIN_RTSP=y
BR2_PACKAGE_GST1_RTSP_SERVER=y
BR2_PACKAGE_GDB=y
BR2_PACKAGE_GDB_DEBUGGER=y
BR2_PACKAGE_MTD=y
# BR2_PACKAGE_MTD_NANDDUMP is not set
# BR2_PACKAGE_MTD_NANDTEST is not set
# BR2_PACKAGE_MTD_NANDWRITE is not set
# BR2_PACKAGE_MTD_UBIATTACH is not set
# BR2_PACKAGE_MTD_UBICRC32 is not set
# BR2_PACKAGE_MTD_UBIDETACH is not set
# BR2_PACKAGE_MTD_UBIFORMAT is not set
# BR2_PACKAGE_MTD_UBIMKVOL is not set
# BR2_PACKAGE_MTD_UBINFO is not set
# BR2_PACKAGE_MTD_UBINIZE is not set
# BR2_PACKAGE_MTD_UBIRENAME is not set
# BR2_PACKAGE_MTD_UBIRMVOL is not set
# BR2_PACKAGE_MTD_UBIRSVOL is not set
# BR2_PACKAGE_MTD_UBIUPDATEVOL is not set
# BR2_PACKAGE_MTD_UBIBLOCK is not set
BR2_PACKAGE_LINUX_FIRMWARE=y
BR2_PACKAGE_INPUT_EVENT_DAEMON=y
BR2_PACKAGE_UBOOT_TOOLS=y
BR2_PACKAGE_PYTHON3=y
BR2_PACKAGE_LIBIIO_IIOD_USBD=y
BR2_PACKAGE_LIBIIO_TESTS=y
BR2_PACKAGE_GSL=y
BR2_PACKAGE_GNURADIO_AUDIO=y
BR2_PACKAGE_GNURADIO_PYTHON=y
BR2_PACKAGE_GNURADIO_UTILS=y
BR2_PACKAGE_GNURADIO_CHANNELS=y
BR2_PACKAGE_GNURADIO_DIGITAL=y
BR2_PACKAGE_GR_OSMOSDR=y
BR2_PACKAGE_AVAHI=y
BR2_PACKAGE_AVAHI_DAEMON=y
BR2_PACKAGE_AVAHI_LIBDNSSD_COMPATIBILITY=y
BR2_PACKAGE_DROPBEAR=y
BR2_PACKAGE_IPERF3=y
BR2_PACKAGE_IPROUTE2=y
BR2_PACKAGE_HTOP=y
BR2_PACKAGE_NANO=y
BR2_TARGET_ROOTFS_EXT2=y
BR2_TARGET_ROOTFS_EXT2_4=y
BR2_TARGET_ROOTFS_EXT2_SIZE="150M"
# BR2_TARGET_ROOTFS_TAR is not set
BR2_TARGET_UBOOT=y
BR2_TARGET_UBOOT_BUILD_SYSTEM_KCONFIG=y
BR2_TARGET_UBOOT_CUSTOM_GIT=y
BR2_TARGET_UBOOT_CUSTOM_REPO_URL="https://github.com/analogdevicesinc/u-boot-xlnx.git"
BR2_TARGET_UBOOT_CUSTOM_REPO_VERSION="d244ce5"
BR2_TARGET_UBOOT_BOARD_DEFCONFIG="zynq_adrv9364"
BR2_TARGET_UBOOT_CONFIG_FRAGMENT_FILES="$(BR2_EXTERNAL)/targets/adrv9364/uboot-extras.config"
# BR2_TARGET_UBOOT_FORMAT_BIN is not set
BR2_TARGET_UBOOT_FORMAT_ELF=y
BR2_PACKAGE_HOST_DOSFSTOOLS=y
BR2_PACKAGE_HOST_ENVIRONMENT_SETUP=y
BR2_PACKAGE_HOST_GENIMAGE=y
BR2_PACKAGE_HOST_PYTHON_CYTHON=y
VIVADO_VERSION="2021.2"
VIVADO_SETTINGS="/tools/Xilinx/Vivado/$(VIVADO_VERSION)/settings64.sh"
HDL_PROJECT="adrv9364z7020_ccbob_lvds"
COMPLETE_NAME="ADRV9364Z7020"
BR2_PACKAGE_LIBINI=y
BR2_PACKAGE_POLL_SYSFS=y
BR2_PACKAGE_AD936X_REF_CAL=y
BR2_PACKAGE_AD9361_DTS=y
BR2_PACKAGE_MOTD=y
BR2_PACKAGE_MOTD_ADRV9364=y
BR2_PACKAGE_RETROGRAM_PLUTOSDR=y
BR2_PACKAGE_IIO_FM_RADIO=y
BR2_PACKAGE_XFFT_TEST=y
BR2_PACKAGE_SISO=y
BR2_PACKAGE_ZMQ_ROUTING=y
```

## targets/pluto/defconfig
```kconfig
BR2_arm=y
BR2_cortex_a9=y
BR2_ARM_ENABLE_NEON=y
BR2_ARM_ENABLE_VFP=y
BR2_ARM_FPU_NEON=y
BR2_HOST_DIR="$(BR2_EXTERNAL)/build/host"
BR2_CCACHE=y
BR2_GLOBAL_PATCH_DIR="$(BR2_EXTERNAL)/patches/"
BR2_REPRODUCIBLE=y
# BR2_PIC_PIE is not set
BR2_SSP_NONE=y
BR2_RELRO_NONE=y
BR2_FORTIFY_SOURCE_NONE=y
BR2_TOOLCHAIN_BUILDROOT_GLIBC=y
BR2_PACKAGE_HOST_LINUX_HEADERS_CUSTOM_5_4=y
BR2_BINUTILS_VERSION_2_38_X=y
BR2_GCC_VERSION_11_X=y
BR2_TOOLCHAIN_BUILDROOT_CXX=y
BR2_TOOLCHAIN_BUILDROOT_FORTRAN=y
BR2_GCC_ENABLE_LTO=y
BR2_GCC_ENABLE_OPENMP=y
BR2_GCC_ENABLE_GRAPHITE=y
BR2_TARGET_GENERIC_HOSTNAME="pluto"
BR2_TARGET_GENERIC_ISSUE="Welcome to Pluto"
BR2_ROOTFS_DEVICE_CREATION_DYNAMIC_MDEV=y
BR2_ROOTFS_MERGED_USR=y
BR2_TARGET_GENERIC_ROOT_PASSWD="analog"
BR2_TARGET_GENERIC_GETTY_PORT="ttyPS0"
BR2_ROOTFS_OVERLAY="$(BR2_EXTERNAL)/platform/rootfs_overlay/"
BR2_ROOTFS_POST_BUILD_SCRIPT="$(BR2_EXTERNAL)/platform/post-build.sh"
BR2_ROOTFS_POST_IMAGE_SCRIPT="$(BR2_EXTERNAL)/targets/pluto/post-image.sh"
BR2_LINUX_KERNEL=y
BR2_LINUX_KERNEL_CUSTOM_GIT=y
BR2_LINUX_KERNEL_CUSTOM_REPO_URL="https://github.com/analogdevicesinc/linux.git"
BR2_LINUX_KERNEL_CUSTOM_REPO_VERSION="424e677"
BR2_LINUX_KERNEL_DEFCONFIG="zynq_pluto"
BR2_LINUX_KERNEL_CONFIG_FRAGMENT_FILES="$(BR2_EXTERNAL)/targets/pluto/linux-extras.config"
BR2_LINUX_KERNEL_XZ=y
BR2_LINUX_KERNEL_DTS_SUPPORT=y
BR2_LINUX_KERNEL_INTREE_DTS_NAME="zynq-pluto-sdr zynq-pluto-sdr-revb zynq-pluto-sdr-revc"
BR2_LINUX_KERNEL_CUSTOM_DTS_PATH="$(BASE_DIR)/dts/*.dtsi $(BR2_EXTERNAL)/targets/pluto/*.dtsi"
BR2_PACKAGE_BUSYBOX_CONFIG="$(BR2_EXTERNAL)/platform/busybox-1.25.0.config"
BR2_PACKAGE_BUSYBOX_CONFIG_FRAGMENT_FILES="$(BR2_EXTERNAL)/platform/busybox-extras.config"
BR2_PACKAGE_BUSYBOX_SHOW_OTHERS=y
BR2_PACKAGE_GDB=y
BR2_PACKAGE_GDB_SERVER=y
BR2_PACKAGE_GDB_DEBUGGER=y
BR2_PACKAGE_GDB_TUI=y
BR2_PACKAGE_MTD=y
BR2_PACKAGE_MTD_MKFSJFFS2=y
# BR2_PACKAGE_MTD_NANDDUMP is not set
# BR2_PACKAGE_MTD_NANDTEST is not set
# BR2_PACKAGE_MTD_NANDWRITE is not set
# BR2_PACKAGE_MTD_UBIATTACH is not set
# BR2_PACKAGE_MTD_UBICRC32 is not set
# BR2_PACKAGE_MTD_UBIDETACH is not set
# BR2_PACKAGE_MTD_UBIFORMAT is not set
# BR2_PACKAGE_MTD_UBIMKVOL is not set
# BR2_PACKAGE_MTD_UBINFO is not set
# BR2_PACKAGE_MTD_UBINIZE is not set
# BR2_PACKAGE_MTD_UBIRENAME is not set
# BR2_PACKAGE_MTD_UBIRMVOL is not set
# BR2_PACKAGE_MTD_UBIRSVOL is not set
# BR2_PACKAGE_MTD_UBIUPDATEVOL is not set
# BR2_PACKAGE_MTD_UBIBLOCK is not set
BR2_PACKAGE_NFS_UTILS=y
BR2_PACKAGE_LINUX_FIRMWARE=y
BR2_PACKAGE_INPUT_EVENT_DAEMON=y
BR2_PACKAGE_UBOOT_TOOLS=y
BR2_PACKAGE_PYTHON3=y
BR2_PACKAGE_LIBIIO_IIOD_USBD=y
BR2_PACKAGE_LIBIIO_TESTS=y
BR2_PACKAGE_YAML_CPP=y
BR2_PACKAGE_SPDLOG=y
BR2_PACKAGE_LIQUID_DSP=y
BR2_PACKAGE_LIQUID_DSP_FAST=y
BR2_PACKAGE_GNURADIO_AUDIO=y
BR2_PACKAGE_GNURADIO_CTRLPORT=y
BR2_PACKAGE_GNURADIO_FEC=y
BR2_PACKAGE_GNURADIO_PYTHON=y
BR2_PACKAGE_GNURADIO_CHANNELS=y
BR2_PACKAGE_GNURADIO_DIGITAL=y
BR2_PACKAGE_GR_OSMOSDR=y
BR2_PACKAGE_AVAHI=y
BR2_PACKAGE_AVAHI_DAEMON=y
BR2_PACKAGE_AVAHI_LIBDNSSD_COMPATIBILITY=y
BR2_PACKAGE_DROPBEAR=y
BR2_PACKAGE_DROPBEAR_MOTD=y
BR2_PACKAGE_IPERF3=y
BR2_PACKAGE_IPROUTE2=y
BR2_PACKAGE_NETCAT_OPENBSD=y
BR2_PACKAGE_RSYNC=y
BR2_PACKAGE_HTOP=y
BR2_PACKAGE_UTIL_LINUX_MOUNT=y
BR2_PACKAGE_NANO=y
BR2_TARGET_ROOTFS_CPIO=y
BR2_TARGET_ROOTFS_CPIO_XZ=y
# BR2_TARGET_ROOTFS_TAR is not set
BR2_TARGET_UBOOT=y
BR2_TARGET_UBOOT_BUILD_SYSTEM_KCONFIG=y
BR2_TARGET_UBOOT_CUSTOM_GIT=y
BR2_TARGET_UBOOT_CUSTOM_REPO_URL="https://github.com/analogdevicesinc/u-boot-xlnx.git"
BR2_TARGET_UBOOT_CUSTOM_REPO_VERSION="af19d59"
BR2_TARGET_UBOOT_BOARD_DEFCONFIG="zynq_pluto"
# BR2_TARGET_UBOOT_FORMAT_BIN is not set
BR2_TARGET_UBOOT_FORMAT_ELF=y
BR2_PACKAGE_HOST_DOSFSTOOLS=y
BR2_PACKAGE_HOST_GENIMAGE=y
BR2_PACKAGE_HOST_PYTHON_CYTHON=y
BR2_PACKAGE_HOST_UBOOT_TOOLS=y
VIVADO_VERSION="2021.2"
VIVADO_SETTINGS="/tools/Xilinx/Vivado/$(VIVADO_VERSION)/settings64.sh"
COMPLETE_NAME="PlutoSDR"
BR2_PACKAGE_LIBINI=y
BR2_PACKAGE_POLL_SYSFS=y
BR2_PACKAGE_AD936X_REF_CAL=y
BR2_PACKAGE_AD9361_DTS=y
BR2_PACKAGE_PLUTO_OVERLAY=y
BR2_PACKAGE_RETROGRAM_PLUTOSDR=y
BR2_PACKAGE_IIO_FM_RADIO=y
BR2_PACKAGE_XFFT_TEST=y
BR2_PACKAGE_SISO=y
```
